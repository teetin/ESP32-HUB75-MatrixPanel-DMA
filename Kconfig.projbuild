## Kconfig.projbuild
```kconfig
menu "ESP32 HUB75 Configuration"

  choice ESP32_HUB75_GFX_LIBRARY
      prompt "GFX Library"
      default ESP32_HUB75_USE_GFX_LITE
      help
          Select which GFX library to use.

      config ESP32_HUB75_USE_GFX
          bool "Adafruit GFX"
          help
              This option enables use of the Adafruit GFX library using the `Adafruit-GFX-Library` component.

      config ESP32_HUB75_USE_GFX_LITE
          bool "GFX Lite"
          help
              This option enables use of the GFX Lite library.

      config ESP32_HUB75_NO_GFX
          bool "None"
          help
              Disable GFX library support.

      config ESP32_HUB75_USE_LVGL
          bool "LVGL"
          help
              This option enables use of the LVGL library.
  endchoice

  config ESP32_HUB75_FORCE_GPIO
      bool "Force GPIO bit-bang driver"
      default n
      help
          Force the use of the GPIO bit-bang driver even on platforms that support DMA/I2S.
          This is useful for debugging or if the DMA driver is causing issues.

endmenu
```
